## kpatch/security/memhide_test/Kconfig
```kconfig
config MEMHIDE_TEST
	bool "Memory-map research test support"
	depends on SECURITY
	default n
	help
	  Builds the minimal memhide-test in-tree research experiment. Filtering
	  is enabled only together with MEMHIDE_TEST_AUDIT and its hard-coded
	  QEMU test policy.

	  If unsure, say N.

config MEMHIDE_TEST_AUDIT
	bool "Trace /proc/self/maps VMA emission (test only)"
	depends on MEMHIDE_TEST && TRACING
	default n
	help
	  Emits a trace event for each VMA considered while a task reads its own
	  /proc/self/maps. For the QEMU experiment, UID 12345 also suppresses
	  shared-anonymous VMAs. This hard-coded policy is test-only.
```
